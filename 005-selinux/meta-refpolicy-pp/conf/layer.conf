## 005-selinux/meta-refpolicy-pp/conf/layer.conf
```bitbake
# We have a conf and classes directory, add to BBPATH
BBPATH .= ":${LAYERDIR}"

# We have recipes-* directories, add to BBFILES
BBFILES += "${LAYERDIR}/recipes-*/*/*.bb \
	${LAYERDIR}/recipes-*/*/*.bbappend"

BBFILE_COLLECTIONS += "refpolicy-pp"
BBFILE_PATTERN_refpolicy-pp = "^${LAYERDIR}/"
BBFILE_PRIORITY_refpolicy-pp = "6"
```
